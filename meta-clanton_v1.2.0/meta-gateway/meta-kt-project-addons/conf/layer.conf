## meta-clanton_v1.2.0/meta-gateway/meta-kt-project-addons/conf/layer.conf
```bitbake
# We have a conf and classes directory, add to BBPATH
BBPATH .= ":${LAYERDIR}"

# We have recipes-* directories, add to BBFILES
BBFILES += "${LAYERDIR}/recipes-*/*/*.bbappend"

BBFILE_COLLECTIONS += "kt-project-addons"
BBFILE_PATTERN_kt-project-addons = "^${LAYERDIR}/"
BBFILE_PRIORITY_kt-project-addons = "10"
```
